VERSION ""

NS_ :

BS_:

BU_: JETSON ARM GIMBAL PDB SCIENCE

BO_ 0 ARM_setControlMode: 8 JETSON
 SG_ ARM_shoulderControlMode : 3|3@1+ (1.0,0.0) [0.0|0.0] ""  ARM
 SG_ ARM_turntableControlMode : 0|3@1+ (1.0,0.0) [0.0|0.0] ""  ARM

BO_ 1 ARM_setMotionData: 8 JETSON
 SG_ ARM_shoulderMotionData : 16|16@1+ (0.000152587890625,-5.0) [-5.0|5.0] "radians"  ARM
 SG_ ARM_turntableMotionData : 0|16@1+ (0.000152587890625,-5.0) [-5.0|5.0] "radians"  ARM

CM_ BO_ 0 "Set control mode for arm joints";
CM_ SG_ 0 ARM_shoulderControlMode "Arm shoulder PID control mode";
CM_ SG_ 0 ARM_turntableControlMode "Arm turntable PID control mode";
CM_ BO_ 1 "Set motion data for arm joints";
CM_ SG_ 1 ARM_shoulderMotionData "Arm shoulder motion data";
CM_ SG_ 1 ARM_turntableMotionData "Arm turntable motion data";

VAL_ 0 ARM_shoulderControlMode 0 "OPEN_LOOP" 1 "POSITION" 2 "VELOCITY" 3 "CURRENT" 7 "SNA" ;
VAL_ 0 ARM_turntableControlMode 0 "OPEN_LOOP" 1 "POSITION" 2 "VELOCITY" 3 "CURRENT" 7 "SNA" ;
VAL_ 1 ARM_shoulderMotionData 65535 "SNA" ;
VAL_ 1 ARM_turntableMotionData 65535 "SNA" ;
